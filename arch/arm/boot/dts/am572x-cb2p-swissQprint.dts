// SPDX-License-Identifier: (GPL-2.0+ OR MIT)
/*
 * Device Tree file for TQ AM572x baseboard MBa57xx.
 *
 * Copyright 2020 TQ-Systems GmbH
 *
 * Author: Michael Krummsdorf <michael.krummsdorf@tq-group.com>
 */

/dts-v1/;

#include "am572x-tqma57xx.dtsi"
#include "am57xx-cb2p-swissQprint.dtsi"

/ {
	model = "SQP TQMa5728 CB2+";
	compatible = "tq,am5728-mba57xx", "tq,tqma5728", "ti,am5728",
		     "ti,dra742", "ti,dra74", "ti,dra7";

};

/* PCIe lane 1 mPCIe connector */
&pcie2_rc {
	status = "disabled";
	/* PCIe reset R532 not placed */
};

&pcie2_phy {
	status = "disabled";
};

// Test without ethercat...
// #include "am57xx-swissQprint-ethercat-pru.dtsi"
